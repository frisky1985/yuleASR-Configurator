AUTOSAR XML (schema 4.0)
package /EcucValues
  module config Can: CanMainFunctionPeriod=10, CanControllerMode=HW
    CanController: CanControllerBaudRate=500000
package /EcucDefs
  module definition Can
    parameter-defs:
      integer CanMainFunctionPeriod
      string CanControllerMode
    container CanController
      parameter-defs:
        integer CanControllerBaudRate
